## meta-bsp/conf/distro/home-gateway.conf
```bitbake
require conf/distro/poky.conf

DISTRO = "home-gateway"
DISTRO_NAME = "Smart Home Gateway"
DISTRO_VERSION = "1.0"

DISTRO_FEATURES:remove = " \
    x11 \
    wayland \
    opengl \
    vulkan \
    bluetooth \
    nfc \
    3g \
    ppp \
    pcmcia \
    wifi \
    alsa \
    pulseaudio \
    gobject-introspection-data \
    pci \
    zeroconf \
    debuginfod \
    multiarch \
"

DISTRO_FEATURES:append = " systemd"
VIRTUAL-RUNTIME_init_manager = "systemd"
DISTRO_FEATURES_BACKFILL_CONSIDERED += "sysvinit"
VIRTUAL_RUNTIME_initscripts = "systemd-compat-units"

PACKAGECONFIG_DISTRO:pn-qtbase = " \
    linuxfb \
    tslib \
    fontconfig \
"

TOOLCHAIN_TARGET_TASK:append = " \
    libgpiod-dev \
    mosquitto-dev \
"
```

## meta-bsp/conf/layer.conf
```bitbake
# Layer:  meta-bsp
# Path:   meta-home-gateway/meta-bsp

BBPATH .= ":${LAYERDIR}"

BBFILES += "${LAYERDIR}/recipes-*/*/*.bb \
            ${LAYERDIR}/recipes-*/*/*.bbappend"

BBFILE_COLLECTIONS += "home-gateway-bsp"
BBFILE_PATTERN_home-gateway-bsp = "^${LAYERDIR}/"
BBFILE_PRIORITY_home-gateway-bsp = "6"

LAYERDEPENDS_home-gateway-bsp     = "core"
LAYERSERIES_COMPAT_home-gateway-bsp = "kirkstone"
```

## meta-ota/conf/layer.conf
```bitbake
#
# Layer:  meta-ota
# Path:   meta-home-gateway/meta-ota
#

BBPATH .= ":${LAYERDIR}"

BBFILES += "${LAYERDIR}/recipes-*/*/*.bb \
            ${LAYERDIR}/recipes-*/*/*.bbappend"

BBFILE_COLLECTIONS += "home-gateway-ota"
BBFILE_PATTERN_home-gateway-ota = "^${LAYERDIR}/"
BBFILE_PRIORITY_home-gateway-ota = "10"

# Layer dependencies:
LAYERDEPENDS_home-gateway-ota     = "core swupdate home-gateway-bsp"
LAYERSERIES_COMPAT_home-gateway-ota = "kirkstone"
```

## meta-ota/wic/bbb-ota.wks
```
bootloader --ptable msdos

part --source rawcopy --ondisk mmcblk0 --no-table --align 128  --sourceparams="file=MLO"
part --source rawcopy --ondisk mmcblk0 --no-table --align 384  --sourceparams="file=u-boot.img"
part --source rawcopy --ondisk mmcblk0 --no-table --align 2432 --sourceparams="file=u-boot-env.raw"

part /     --source rootfs --ondisk mmcblk0 --fstype=ext4 --label rootA --align 4096 --fixed-size 160 --active --use-uuid
part       --source empty  --ondisk mmcblk0 --fstype=ext4 --label rootB --align 4096 --fixed-size 160 --use-uuid
part /data                 --ondisk mmcblk0 --fstype=ext4 --label data  --align 4096 --fixed-size 128 --use-uuid
```
