## meta-bsp/conf/machine/bbb-home-gateway.conf
```bitbake
#
# Machine:  bbb-home-gateway
# Base:     beaglebone-yocto (poky/meta-yocto-bsp)
#

require conf/machine/beaglebone-yocto.conf

MACHINEOVERRIDES =. "beaglebone-yocto:"

UBOOT_SIGN_ENABLE       = "${@bb.utils.contains('DISTRO_FEATURES', 'secure-boot', '1', '0', d)}"
UBOOT_SIGN_KEYDIR       = "${TOPDIR}/keys"
UBOOT_SIGN_KEYNAME      = "dev"

UBOOT_DTB_BINARY        = "u-boot.dtb"
UBOOT_NODTB_BINARY      = "u-boot-nodtb.bin"

UBOOT_ENTRYPOINT        = "0x80008000"
UBOOT_LOADADDRESS       = "0x80008000"
UBOOT_DTB_LOADADDRESS   = "0x88000000"

# Tự sinh key RSA2048 vào ${TOPDIR}/keys/ nếu chưa có
FIT_GENERATE_KEYS       = "${@bb.utils.contains('DISTRO_FEATURES', 'secure-boot', '1', '0', d)}"
FIT_SIGN_ALG            = "rsa2048"
FIT_HASH_ALG            = "sha256"

KERNEL_IMAGETYPE        = "${@bb.utils.contains('DISTRO_FEATURES', 'secure-boot', 'fitImage', 'zImage', d)}"
KERNEL_CLASSES:append   = "${@bb.utils.contains('DISTRO_FEATURES', 'secure-boot', ' kernel-fitimage', '', d)}"

# FIT image thêm initramfs
INITRAMFS_IMAGE         = "${@bb.utils.contains('DISTRO_FEATURES', 'secure-boot', 'home-gateway-initramfs', '', d)}"
INITRAMFS_IMAGE_BUNDLE  = "0"

MACHINE_ESSENTIAL_EXTRA_RDEPENDS:remove = "kernel-image kernel-devicetree"

# Override KERNEL_DEVICETREE: chỉ giữ DTB của BBB — loại bỏ am335x-bone và bonegreen
# để FIT image chỉ có một config duy nhất (conf-am335x-boneblack.dtb làm default)
KERNEL_DEVICETREE       = "am335x-boneblack.dtb"
```
